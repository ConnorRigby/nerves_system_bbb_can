## uboot/kernel.its
```
/dts-v1/;
/ {
    description = "CANLink Firmware";
    #address-cells = <1>;

    images {
        kernel-1 {
            data = /incbin/("zImage");
            type = "kernel";
            arch = "arm";
            os = "linux";
            compression = "none";
            load = <0x80008000>;
            entry = <0x80008000>;

            hash-1 {
                algo = "sha1";
            };
        };

        fdt-1 {
            description = "am335x-canlink.dtb";
            data = /incbin/("am335x-canlink.dtb");
            type = "flat_dt";
            arch = "arm";
            compression = "none";

            hash-1 {
                algo = "sha1";
            };
        };
    };

    configurations {
        default = "conf-1";
        conf-1 {
            kernel = "kernel-1";
            fdt = "fdt-1";
        };
    };
};
```
